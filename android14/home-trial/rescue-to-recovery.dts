/dts-v1/;
/plugin/;

&{/soc/system-controller@10040000/reboot-mode-inform3} {
    mode-RescueParty = <0x12345674>;
};

&{/soc/system-controller@10040000/reboot-mode-inform2} {
    mode-RescueParty = <0x12345678>;
};
