// SPDX-License-Identifier: GPL-2.0-only
/dts-v1/;
/plugin/;

/ {
    fragment@0 {
        target-path = "/soc/usb@12400000";
        __overlay__ {
            status = "disabled";
        };
    };
};
