// SPDX-License-Identifier: GPL-2.0-only
/dts-v1/;
/plugin/;

/ {
    fragment@0 {
        target-path = "/";
        __overlay__ {
            #address-cells = <1>;
            #size-cells = <1>;
            reserved-memory {
                #address-cells = <1>;
                #size-cells = <1>;
                ranges;

                ramoops@40000000 {
                    compatible = "ramoops";
                    reg = <0x40000000 0x200000>;
                    console-size = <0x200000>;
                    ecc-size = <16>;
                };
            };
        };
    };
};
